/dts-v1/;
/plugin/;

/ {
    compatible = "brcm,bcm2835";

    fragment@0 {
        target = <&i2c1>;

        __overlay__ {
            status = "okay";
            #address-cells = <0x01>;
            #size-cells = <0x00>;

            roxy_rtc@68 {
                reg = <0x68>;
                compatible = "roxyrtc";
            };
        };
    };
};